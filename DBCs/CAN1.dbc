VERSION ""

NS_ :

BS_:

BU_:

BO_ 3221225472 VECTOR__INDEPENDENT_SIG_MSG: 0 Vector__XXX
 SG_ M400_oilTemp : 0|16@0- (0.1,0) [-3276.8|3276.7] "" Vector__XXX
 SG_ M400_oilPressure : 0|16@0- (0.1,0) [-3276.8|3276.7] "" Vector__XXX
 SG_ M400_manifoldPressure : 0|16@0- (0.1,0) [-3276.8|3276.7] "" Vector__XXX
 SG_ M400_la1LongTermTrim : 0|16@0- (0.1,0) [-3276.8|3276.7] "" Vector__XXX
 SG_ M400_inletAirTemp : 0|16@0- (0.1,0) [-3276.8|3276.7] "" Vector__XXX
 SG_ M400_ignMapComp : 0|16@0- (1,0) [-32768|32767] "" Vector__XXX
 SG_ M400_ignEtComp : 0|16@0- (1,0) [-32768|32767] "" Vector__XXX
 SG_ M400_ignComp2 : 0|16@0- (1,0) [-32768|32767] "" Vector__XXX
 SG_ M400_ignComp1 : 0|16@0- (1,0) [-32768|32767] "" Vector__XXX
 SG_ M400_ignBaseAdvance : 0|16@0- (0.1,0) [-3276.8|3276.7] "" Vector__XXX
 SG_ M400_ignAtComp : 0|16@0- (1,0) [-32768|32767] "" Vector__XXX
 SG_ M400_ign4Advance : 0|16@0- (0.1,0) [-3276.8|3276.7] "" Vector__XXX
 SG_ M400_ign3Advance : 0|16@0- (0.1,0) [-3276.8|3276.7] "" Vector__XXX
 SG_ M400_ign2Advance : 0|16@0- (0.1,0) [-3276.8|3276.7] "" Vector__XXX
 SG_ M400_ign1Advance : 0|16@0- (0.1,0) [-3276.8|3276.7] "" Vector__XXX
 SG_ M400_fuelUsed : 0|16@0- (1,0) [-32768|32767] "" Vector__XXX
 SG_ M400_fuelTemp : 0|16@0- (1,0) [-32768|32767] "" Vector__XXX
 SG_ M400_fuelStartingComp : 0|16@0- (1,0) [-32768|32767] "" Vector__XXX
 SG_ M400_fuelPressure : 0|16@0- (0.1,0) [-3276.8|3276.7] "" Vector__XXX
 SG_ M400_fuelMapComp : 0|16@0- (1,0) [-32768|32767] "" Vector__XXX
 SG_ M400_fuelLambdaComp : 0|16@0- (1,0) [-32768|32767] "" Vector__XXX
 SG_ M400_fuelInjDutyCycle : 0|16@0- (0.1,0) [-3276.8|3276.7] "" Vector__XXX
 SG_ M400_fuelFtComp : 0|16@0- (1,0) [-32768|32767] "" Vector__XXX
 SG_ M400_fuelFpComp : 0|16@0- (1,0) [-32768|32767] "" Vector__XXX
 SG_ M400_fuelEtComp : 0|16@0- (1,0) [-32768|32767] "" Vector__XXX
 SG_ M400_fuelComp2 : 0|16@0- (1,0) [-32768|32767] "" Vector__XXX
 SG_ M400_fuelComp1 : 0|16@0- (1,0) [-32768|32767] "" Vector__XXX
 SG_ M400_fuelAtComp : 0|16@0- (1,0) [-32768|32767] "" Vector__XXX
 SG_ M400_fuelAcutalPulseW : 0|16@0- (0.002,0) [-65.536|65.534] "" Vector__XXX
 SG_ M400_fuel4IndivTrim : 0|16@0- (1,0) [-32768|32767] "" Vector__XXX
 SG_ M400_fuel3IndivTrim : 0|16@0- (1,0) [-32768|32767] "" Vector__XXX
 SG_ M400_fuel2IndivTrim : 0|16@0- (1,0) [-32768|32767] "" Vector__XXX
 SG_ M400_fuel1IndivTrim : 0|16@0- (1,0) [-32768|32767] "" Vector__XXX
 SG_ M400_exhaustGasTemp4 : 0|16@0- (1,0) [-32768|32767] "" Vector__XXX
 SG_ M400_exhaustGasTemp3 : 0|16@0- (1,0) [-32768|32767] "" Vector__XXX
 SG_ M400_exhaustGasTemp2 : 0|16@0- (1,0) [-32768|32767] "" Vector__XXX
 SG_ M400_exhaustGasTemp1 : 0|16@0- (1,0) [-32768|32767] "" Vector__XXX
 SG_ M400_engineTemp : 0|16@0- (0.1,0) [-3276.8|3276.7] "" Vector__XXX
 SG_ M400_ecuInternalTemp : 0|16@0- (0.1,0) [-3276.8|3276.7] "" Vector__XXX
 SG_ M400_ecuCpuUsage : 0|16@0- (0.1,0) [-3276.8|3276.7] "" Vector__XXX
 SG_ M400_batteryVoltage : 0|16@0- (0.01,0) [-327.68|327.67] "" Vector__XXX
 SG_ M400_auxOut8DutyCycle : 0|16@0- (1,0) [-32768|32767] "" Vector__XXX
 SG_ M400_auxOut7DutyCycle : 0|16@0- (1,0) [-32768|32767] "" Vector__XXX
 SG_ M400_auxOut6DutyCycle : 0|16@0- (1,0) [-32768|32767] "" Vector__XXX
 SG_ M400_auxOut5DutyCycle : 0|16@0- (1,0) [-32768|32767] "" Vector__XXX
 SG_ M400_auxOut4DutyCycle : 0|16@0- (1,0) [-32768|32767] "" Vector__XXX
 SG_ M400_auxOut3DutyCycle : 0|16@0- (1,0) [-32768|32767] "" Vector__XXX
 SG_ M400_auxOut2DutyCycle : 0|16@0- (1,0) [-32768|32767] "" Vector__XXX
 SG_ M400_auxOut1DutyCycle : 0|16@0- (1,0) [-32768|32767] "" Vector__XXX
 SG_ M400_wheelSlip : 0|16@0- (0.1,0) [-3276.8|3276.7] "" Vector__XXX
 SG_ M400_throttlePosition : 0|16@0- (0.1,0) [-3276.8|3276.7] "" Vector__XXX
 SG_ M400_tcSlipAimValue : 0|16@0- (0.1,0) [-3276.8|3276.7] "" Vector__XXX
 SG_ M400_tcSlipAimError : 0|16@0- (0.1,0) [-3276.8|3276.7] "" Vector__XXX
 SG_ M400_tcPowerReduction : 0|16@0- (0.1,0) [-3276.8|3276.7] "" Vector__XXX
 SG_ M400_launchAimRPM : 0|16@0- (1,0) [-32768|32767] "" Vector__XXX
 SG_ M400_tcIgnretard : 0|16@0- (1,0) [-32768|32767] "" Vector__XXX
 SG_ M400_RPM : 0|16@0- (1,0) [-32768|32767] "" Vector__XXX
 SG_ M400_groundSpeedRight : 0|16@0- (0.1,0) [-3276.8|3276.7] "" Vector__XXX
 SG_ M400_driveSpeedRight : 0|16@0- (0.1,0) [-3276.8|3276.7] "" Vector__XXX
 SG_ M400_groundSpeedLeft : 0|16@0- (0.1,0) [-3276.8|3276.7] "" Vector__XXX
 SG_ M400_driveSpeedLeft : 0|16@0- (0.1,0) [-3276.8|3276.7] "" Vector__XXX
 SG_ M400_lambda1 : 0|16@0- (0.001,0) [-32.768|32.767] "" Vector__XXX
 SG_ M400_la1ShortTermTrim : 0|16@0- (0.01,0) [-327.68|327.67] "" Vector__XXX
 SG_ M400_la1AimValue : 0|16@0- (0.001,0) [-32.768|32.767] "" Vector__XXX
 SG_ M400_overallTrim : 0|16@0- (1,0) [-32768|32767] "" Vector__XXX
 SG_ M400_ignCutLevelTotal : 0|16@0- (1,0) [-32768|32767] "" Vector__XXX
 SG_ M400_groundSpeed : 0|16@0- (0.1,0) [-3276.8|3276.7] "" Vector__XXX
 SG_ M400_gearSensorVoltage : 0|16@0- (0.001,0) [-32.768|32.767] "" Vector__XXX
 SG_ M400_gearDet : 0|16@0- (1,0) [-32768|32767] "" Vector__XXX
 SG_ M400_gear : 0|16@0- (1,0) [-32768|32767] "" Vector__XXX
 SG_ M400_fuelOverallTrim : 0|16@0- (0.1,0) [-3276.8|3276.7] "" Vector__XXX
 SG_ M400_fuelCutLevelTotal : 0|16@0- (0.1,0) [-3276.8|3276.7] "" Vector__XXX
 SG_ M400_driveSpeed : 0|16@0- (0.1,0) [-3276.8|3276.7] "" Vector__XXX

CM_ BO_ 3221225472 "This is a message for not used signals, created by Vector CANdb++ DBC OLE DB Provider.";
CM_ SG_ 3221225472 M400_oilTemp "Oil Temp ";
CM_ SG_ 3221225472 M400_oilPressure "Oil Pressure ";
CM_ SG_ 3221225472 M400_manifoldPressure "Manifold Pressure ";
CM_ SG_ 3221225472 M400_la1LongTermTrim "La1 Long Term Trim ";
CM_ SG_ 3221225472 M400_inletAirTemp "Inlet Air Temp ";
CM_ SG_ 3221225472 M400_ignMapComp "Ign MAP Comp ";
CM_ SG_ 3221225472 M400_ignEtComp "Ign ET Comp ";
CM_ SG_ 3221225472 M400_ignComp2 "Ign Comp 2 ";
CM_ SG_ 3221225472 M400_ignComp1 "Ign Comp 1 ";
CM_ SG_ 3221225472 M400_ignBaseAdvance "Ign Base Advance ";
CM_ SG_ 3221225472 M400_ignAtComp "Ign AT Comp ";
CM_ SG_ 3221225472 M400_ign4Advance "Ign 4 Advance ";
CM_ SG_ 3221225472 M400_ign3Advance "Ign 3 Advance ";
CM_ SG_ 3221225472 M400_ign2Advance "Ign 2 Advance ";
CM_ SG_ 3221225472 M400_ign1Advance "Ign 1 Advance ";
CM_ SG_ 3221225472 M400_fuelUsed "Fuel Used ";
CM_ SG_ 3221225472 M400_fuelTemp "Fuel Temp ";
CM_ SG_ 3221225472 M400_fuelStartingComp "Fuel Starting Comp ";
CM_ SG_ 3221225472 M400_fuelPressure "Fuel Pressure ";
CM_ SG_ 3221225472 M400_fuelMapComp "Fuel MAP Comp ";
CM_ SG_ 3221225472 M400_fuelLambdaComp "Fuel Lambda Comp ";
CM_ SG_ 3221225472 M400_fuelInjDutyCycle "Fuel Inj Duty Cycle ";
CM_ SG_ 3221225472 M400_fuelFtComp "Fuel FT Comp ";
CM_ SG_ 3221225472 M400_fuelFpComp "Fuel FP Comp ";
CM_ SG_ 3221225472 M400_fuelEtComp "Fuel ET Comp ";
CM_ SG_ 3221225472 M400_fuelComp2 "Fuel Comp 2";
CM_ SG_ 3221225472 M400_fuelComp1 "Fuel Comp 1 ";
CM_ SG_ 3221225472 M400_fuelAtComp "Fuel AT Comp ";
CM_ SG_ 3221225472 M400_fuelAcutalPulseW "Fuel Actual Pulse W ";
CM_ SG_ 3221225472 M400_fuel4IndivTrim "Fuel 4 Indiv Trim ";
CM_ SG_ 3221225472 M400_fuel3IndivTrim "Fuel 3 Indiv Trim";
CM_ SG_ 3221225472 M400_fuel2IndivTrim "Fuel 2 Indiv Trim ";
CM_ SG_ 3221225472 M400_fuel1IndivTrim "Fuel 1 Indiv Trim ";
CM_ SG_ 3221225472 M400_exhaustGasTemp4 "Exhaust Gas Temp 4";
CM_ SG_ 3221225472 M400_exhaustGasTemp3 "Exhaust Gas Temp 3";
CM_ SG_ 3221225472 M400_exhaustGasTemp2 "Exhaust Gas Temp 2";
CM_ SG_ 3221225472 M400_exhaustGasTemp1 "Exhaust Gas Temp 1";
CM_ SG_ 3221225472 M400_engineTemp "Engine Temp ";
CM_ SG_ 3221225472 M400_ecuInternalTemp "ECU Internal Temp ";
CM_ SG_ 3221225472 M400_ecuCpuUsage "ECU CPU Usage ";
CM_ SG_ 3221225472 M400_batteryVoltage "Battery Voltage";
CM_ SG_ 3221225472 M400_auxOut8DutyCycle "Aux Out8 Duty Cycle";
CM_ SG_ 3221225472 M400_auxOut7DutyCycle "Aux Out7 Duty Cycle ";
CM_ SG_ 3221225472 M400_auxOut6DutyCycle "Aux Out6 Duty Cycle";
CM_ SG_ 3221225472 M400_auxOut5DutyCycle "Aux Out5 Duty Cycle";
CM_ SG_ 3221225472 M400_auxOut4DutyCycle "Aux Out4 Duty Cycle";
CM_ SG_ 3221225472 M400_auxOut3DutyCycle "Aux Out3 Duty Cycle";
CM_ SG_ 3221225472 M400_auxOut2DutyCycle "Aux Out2 Duty Cycle";
CM_ SG_ 3221225472 M400_auxOut1DutyCycle "Aux Out1 Duty Cycle";
CM_ SG_ 3221225472 M400_wheelSlip "Wheel Slip";
CM_ SG_ 3221225472 M400_throttlePosition "Throttle Position ";
CM_ SG_ 3221225472 M400_tcSlipAimValue "TC Slip Aim Value";
CM_ SG_ 3221225472 M400_tcSlipAimError "TC Slip Aim Error";
CM_ SG_ 3221225472 M400_tcPowerReduction "TC Power Reduction";
CM_ SG_ 3221225472 M400_launchAimRPM "TC Launch Aim RPM";
CM_ SG_ 3221225472 M400_tcIgnretard "TC Ign Retard";
CM_ SG_ 3221225472 M400_RPM "RPM";
CM_ SG_ 3221225472 M400_groundSpeedRight "Ground Speed Right";
CM_ SG_ 3221225472 M400_driveSpeedRight "Drive Speed Right";
CM_ SG_ 3221225472 M400_groundSpeedLeft "Ground Speed Left";
CM_ SG_ 3221225472 M400_driveSpeedLeft "Drive Speed Left";
CM_ SG_ 3221225472 M400_lambda1 "Lambda 1  ";
CM_ SG_ 3221225472 M400_la1ShortTermTrim "La1 Short Term Trim ";
CM_ SG_ 3221225472 M400_la1AimValue "La1 Aim Value ";
CM_ SG_ 3221225472 M400_overallTrim "Ign Overall Trim ";
CM_ SG_ 3221225472 M400_ignCutLevelTotal "Ign Cut Level Total ";
CM_ SG_ 3221225472 M400_groundSpeed "Ground Speed";
CM_ SG_ 3221225472 M400_gearSensorVoltage "Gear Sensor Voltage";
CM_ SG_ 3221225472 M400_gearDet "Gear Det ";
CM_ SG_ 3221225472 M400_gear "Gear";
CM_ SG_ 3221225472 M400_fuelOverallTrim "Fuel Overall Trim ";
CM_ SG_ 3221225472 M400_fuelCutLevelTotal "Fuel Cut Level Total 
";
CM_ SG_ 3221225472 M400_driveSpeed "Drive Speed
";
